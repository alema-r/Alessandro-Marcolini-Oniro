## meta-oniro-staging/conf/layer.conf
```bitbake
# SPDX-FileCopyrightText: Huawei Inc.
#
# SPDX-License-Identifier: MIT

# We have a conf directory, add to BBPATH
BBPATH .= ":${LAYERDIR}"

# We have recipes-* directories, add to BBFILES
BBFILES += "${LAYERDIR}/recipes-*/*/*.bb \
            ${LAYERDIR}/recipes-*/*/*.bbappend"

# We have .bbappend files to recipes in layers that we want to have as optional
BBFILES_DYNAMIC += "\
    networking-layer:${LAYERDIR}/dynamic-layers/meta-networking/recipes-*/*/*.bb \
    networking-layer:${LAYERDIR}/dynamic-layers/meta-networking/recipes-*/*/*.bbappend \
    stm-st-stm32mp:${LAYERDIR}/dynamic-layers/meta-st-stm32mp/recipes-*/*/*.bb \
    stm-st-stm32mp:${LAYERDIR}/dynamic-layers/meta-st-stm32mp/recipes-*/*/*.bbappend \
    intel:${LAYERDIR}/dynamic-layers/meta-intel/recipes-*/*/*.bb \
    intel:${LAYERDIR}/dynamic-layers/meta-intel/recipes-*/*/*.bbappend \
    meta-java:${LAYERDIR}/dynamic-layers/meta-java/recipes-*/*/*.bb \
    meta-java:${LAYERDIR}/dynamic-layers/meta-java/recipes-*/*/*.bbappend \
    meta-arm:${LAYERDIR}/dynamic-layers/meta-arm/recipes-*/*/*.bb \
    meta-arm:${LAYERDIR}/dynamic-layers/meta-arm/recipes-*/*/*.bbappend \
"

BBFILE_COLLECTIONS += "oniro-staging"
BBFILE_PATTERN_oniro-staging = "^${LAYERDIR}/"
BBFILE_PRIORITY_oniro-staging = "6"

LAYERDEPENDS_oniro-staging = " \
    core \
    "
LAYERSERIES_COMPAT_oniro-staging = "kirkstone"
```

## meta-patchlayer/conf/layer.conf
```bitbake
# We have a conf and classes directory, add to BBPATH
BBPATH .= ":${LAYERDIR}"

# We have recipes-* directories, add to BBFILES
BBFILES += "${LAYERDIR}/recipes-*/*/*.bb \
            ${LAYERDIR}/recipes-*/*/*.bbappend"

BBFILE_COLLECTIONS += "meta-patchlayer"
BBFILE_PATTERN_meta-patchlayer = "^${LAYERDIR}/"
BBFILE_PRIORITY_meta-patchlayer = "6"

LAYERDEPENDS_meta-patchlayer = "core"
LAYERSERIES_COMPAT_meta-patchlayer = "kirkstone"
```
