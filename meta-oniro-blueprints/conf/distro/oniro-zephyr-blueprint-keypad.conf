## meta-oniro-blueprints/conf/distro/oniro-zephyr-blueprint-keypad.conf
```bitbake
# SPDX-FileCopyrightText: Huawei Inc.
#
# SPDX-License-Identifier: Apache-2.0

# Distro configuration for the keypad blueprint

require conf/distro/oniro-zephyr.conf

DISTRO = "oniro-zephyr-blueprint-keypad"
DISTRO_NAME = "Oniro Project Keypad Blueprint Zephyr Distro"
BBMASK = ""
```

## meta-oniro-blueprints/conf/layer.conf
```bitbake
# SPDX-FileCopyrightText: Huawei Inc.
#
# SPDX-License-Identifier: Apache-2.0

# We have a conf and classes directory, add to BBPATH
BBPATH .= ":${LAYERDIR}"

# We have recipes-* directories, add to BBFILES
BBFILES += "${LAYERDIR}/recipes-*/*/*.bb \
            ${LAYERDIR}/recipes-*/*/*.bbappend"

BBFILE_COLLECTIONS += "oniro-blueprints"
BBFILE_PATTERN_oniro-blueprints = "^${LAYERDIR}/"
BBFILE_PRIORITY_oniro-blueprints = "6"

LAYERDEPENDS_oniro-blueprints = " \
    core \
    homeassistant \
    openembedded-layer \
    oniro-core \
    oniro-staging \
    raspberrypi"
LAYERSERIES_COMPAT_oniro-blueprints = "dunfell"
```

## meta-oniro-core/conf/distro/include/oniro-packageconfig.inc
```bitbake
# SPDX-FileCopyrightText: Huawei Inc.
#
# SPDX-License-Identifier: MIT

# Define the configuration set as per our distro policy
PACKAGECONFIG:pn-networkmanager = "nss systemd bluez5 wifi nmcli"

# We have no use for dlt-daemon as we use systemd for logging
PACKAGECONFIG:remove:pn-mosquitto = "dlt"

# We use NetworkManager as the default network manager (included in our
# reference images).
PACKAGECONFIG:remove:pn-systemd = "networkd wheel-group"

# Enable podman rootless support
PACKAGECONFIG:append:pn-podman = " rootless"
```

## meta-oniro-core/conf/distro/include/oniro-wic.inc
```bitbake
# SPDX-FileCopyrightText: Huawei Inc.
#
# SPDX-License-Identifier: Apache-2.0

# WIC configuration definitions that are meant to be common across the
# supported devices. This configuration is taking into consideration OTA design
# and strategies.

# Boot partition
BOOT_PARTITION_LABEL ?= "boot"
BOOT_PARTITION_SIZE ?= "512M"

# Root partitions
# No label as default filesystem is squashfs.
# The SECO B68 board pulls in almost half a Gigabyte worth of linux-firmware.
ROOT_PARTITION_SIZE:seco-intel-b68 ?= "2G"
ROOT_PARTITION_SIZE ?= "1G"
ROOTA_PARTITION_SIZE = "${ROOT_PARTITION_SIZE}"
ROOTB_PARTITION_SIZE = "${ROOT_PARTITION_SIZE}"

# Device data partition
DEVDATA_PARTITION_LABEL ?= "devdata"
DEVDATA_PARTITION_SIZE ?= "8M"

# System data partition
SYSDATA_PARTITION_LABEL ?= "sysdata"
SYSDATA_PARTITION_SIZE ?= "512M"

# Application data partition
APPDATA_PARTITION_LABEL ?= "appdata"
APPDATA_PARTITION_SIZE ?= "1G"

# Default root filesystem type is squashfs.
ROOT_FSTYPE ?= "squashfs"

WIC_BOOTLOADER_TIMEOUT ?= "5"

#
# Use this to include extra wic configuration per partition
#
WIC_ROOTA_PARTITION_EXTRA_ARGS ??= ""
WIC_ROOTB_PARTITION_EXTRA_ARGS ??= ""
WIC_DEVDATA_PARTITION_EXTRA_ARGS ??= ""
WIC_SYSDATA_PARTITION_EXTRA_ARGS ??= ""
WIC_APPDATA_PARTITION_EXTRA_ARGS ??= ""

WIC_ROOTA_PARTITION ?= "part / --source rootfs --use-uuid --fstype=${ROOT_FSTYPE} \
                        ${@bb.utils.contains('ROOT_FSTYPE', 'ext4', '--mkfs-extraopts \'-T default\'', '', d)} \
                        --align 4096 --fixed-size ${ROOTA_PARTITION_SIZE} \
                        ${WIC_ROOTA_PARTITION_EXTRA_ARGS}"
WIC_ROOTB_PARTITION ?= "part / --source rootfs --use-uuid --fstype=${ROOT_FSTYPE} \
                        ${@bb.utils.contains('ROOT_FSTYPE', 'ext4', '--mkfs-extraopts \'-T default\'', '', d)} \
                        --align 4096 --fixed-size ${ROOTB_PARTITION_SIZE} \
                        ${WIC_ROOTB_PARTITION_EXTRA_ARGS}"
WIC_DEVDATA_PARTITION ?= "part --fstype=ext4 --label ${DEVDATA_PARTITION_LABEL} --mkfs-extraopts '-T default' --align 4096 --fixed-size ${DEVDATA_PARTITION_SIZE} ${WIC_DEVDATA_PARTITION_EXTRA_ARGS}"
WIC_SYSDATA_PARTITION ?= "part --fstype=ext4 --label ${SYSDATA_PARTITION_LABEL} --mkfs-extraopts '-T default' --align 4096 --fixed-size ${SYSDATA_PARTITION_SIZE} ${WIC_SYSDATA_PARTITION_EXTRA_ARGS}"
WIC_APPDATA_PARTITION ?= "part --fstype=ext4 --label ${APPDATA_PARTITION_LABEL} --mkfs-extraopts '-T default' --align 4096 --fixed-size ${APPDATA_PARTITION_SIZE} ${WIC_APPDATA_PARTITION_EXTRA_ARGS}"

# The construction of the image depends on the files deployed by the
# oniro-grub-bootconf package, namely the empty grubenv file.
do_image_wic[depends] += " \
    oniro-grub-bootconf:do_deploy \
"
```

## meta-oniro-core/conf/distro/include/oniro.inc
```bitbake
# SPDX-FileCopyrightText: Huawei Inc.
#
# SPDX-License-Identifier: Apache-2.0

ONIRO_FLAVOUR = "${@'${ONIRO_FLAVOUR_PRETTY}'.lower()}"
DISTRO = "oniro-${ONIRO_FLAVOUR}"
DISTRO_NAME = "Oniro Project Base ${ONIRO_FLAVOUR_PRETTY} Distro"

require conf/distro/include/security_flags.inc

INHERIT += "oniro-sanity"

BB_DANGLINGAPPENDS_WARNONLY:forcevariable = "0"

# Bump this each time bblayers.conf.sample changes incompatibly. For example,
# when integrating new layers.
ONIRO_REQUIRED_LAYERS_CONF_VERSION = "2"
# oe-core's sanity check sanity_check_conffiles function only runs the
# functions in BBLAYERS_CONF_UPDATE_FUNCS when the associated variable is not
# None. Making sure this variable has a default value, we force running the
# check even when ONIRO_LAYERS_CONF_VERSION is not defined - providing the
# relevant error message.
ONIRO_LAYERS_CONF_VERSION ??= "-1"
```

## meta-oniro-core/conf/distro/oniro-freertos.conf
```bitbake
# SPDX-FileCopyrightText: Huawei Inc.
#
# SPDX-License-Identifier: MIT

require conf/distro/freertos.conf
require conf/distro/include/oniro.inc

ONIRO_FLAVOUR_PRETTY = "FreeRTOS"
DISTRO_VERSION = "2.0.0-beta"
```

## meta-oniro-core/conf/distro/oniro-linux.conf
```bitbake
# SPDX-FileCopyrightText: Huawei Inc.
#
# SPDX-License-Identifier: Apache-2.0

ONIRO_FLAVOUR_PRETTY = "Linux"
DISTRO_VERSION = "2.0.0-alpha"
DISTRO_CODENAME = "dev"
SDK_VENDOR = "-onirosdk"
SDK_VERSION = "${@d.getVar('DISTRO_VERSION').replace('snapshot-${DATE}', 'snapshot')}"

MAINTAINER = "Oniro Project <andrei.gherzan@huawei.com>"

TARGET_VENDOR = "-oniro"

LOCALCONF_VERSION = "2"

DISTRO_VERSION[vardepsexclude] = "DATE"
SDK_VERSION[vardepsexclude] = "DATE"

# Override these in oniro based distros
ONIRO_DEFAULT_DISTRO_FEATURES = "largefile opengl ptest multiarch pam rauc security tpm tpm2 wayland vulkan virtualization"
ONIRO_DEFAULT_EXTRA_RDEPENDS = "packagegroup-core-boot"
ONIRO_DEFAULT_EXTRA_RRECOMMENDS = "kernel-module-af-packet"

# Remove some of the default Poky DISTRO_FEATURES_DEFAULT we inherited, but do not use.
# Removing this here allows us to readd them, if the end user requires them.
DISTRO_FEATURES_DEFAULT:remove = " nfs nfc 3g pcmcia x11"

DISTRO_FEATURES ?= "${DISTRO_FEATURES_DEFAULT} ${ONIRO_DEFAULT_DISTRO_FEATURES}"

SDK_NAME = "${DISTRO}-${TCLIBC}-${SDKMACHINE}-${IMAGE_BASENAME}-${TUNE_PKGARCH}-${MACHINE}"
SDKPATHINSTALL = "/opt/${DISTRO}/${SDK_VERSION}"

DISTRO_EXTRA_RDEPENDS += " ${ONIRO_DEFAULT_EXTRA_RDEPENDS}"
DISTRO_EXTRA_RRECOMMENDS += " ${ONIRO_DEFAULT_EXTRA_RRECOMMENDS}"

TCLIBCAPPEND = ""

PREMIRRORS ??= "\
bzr://.*/.*   http://downloads.yoctoproject.org/mirror/sources/ \n \
cvs://.*/.*   http://downloads.yoctoproject.org/mirror/sources/ \n \
git://.*/.*   http://downloads.yoctoproject.org/mirror/sources/ \n \
gitsm://.*/.* http://downloads.yoctoproject.org/mirror/sources/ \n \
hg://.*/.*    http://downloads.yoctoproject.org/mirror/sources/ \n \
osc://.*/.*   http://downloads.yoctoproject.org/mirror/sources/ \n \
p4://.*/.*    http://downloads.yoctoproject.org/mirror/sources/ \n \
svn://.*/.*   http://downloads.yoctoproject.org/mirror/sources/ \n"

SANITY_TESTED_DISTROS ?= " \
            ubuntu-18.04 \n \
            ubuntu-20.04 \n \
            "

require conf/distro/include/no-static-libs.inc
require conf/distro/include/yocto-uninative.inc
INHERIT += "uninative"

BB_SIGNATURE_HANDLER ?= "OEEquivHash"
BB_HASHSERVE ??= "auto"

require conf/distro/include/oniro.inc
require conf/distro/include/oniro-wic.inc
require conf/distro/include/oniro-packageconfig.inc

TCLIBC ?= "musl"

INIT_MANAGER = "systemd"

PREFERRED_VERSION_linux-yocto = "5.10%"
PREFERRED_PROVIDER_virtual/kernel:qemux86 = "linux-oniro"
PREFERRED_PROVIDER_virtual/kernel:qemux86-64 = "linux-oniro"
PREFERRED_PROVIDER_virtual/kernel:qemuarm-efi = "linux-oniro"
PREFERRED_PROVIDER_virtual/kernel:qemuarm64-efi = "linux-oniro"

# Prefer GRUB as the EFI provider.
#
# The SysOTA+RAUC stack supports GRUB as the point of integration. This is
# caused by both RAUC downstream support for GRUB and GRUB's ability to load the
# kernel from a squashfs image.
#
# FIXME: allow GRUB to update the CPU microcode
# https://gitlab.eclipse.org/eclipse/oniro-core/oniro/-/issues/508
EFI_PROVIDER = "grub-efi"
# Add EFI to x86{,-64} QEMU machine features.
MACHINE_FEATURES:qemux86-64 += "efi"
MACHINE_FEATURES:qemux86 += "efi"

# Add bootindex to qemu boot device to prevent boot order from being changed in ovmf file
# and not break boot order with EFI. See qemuboot.bbclass for more information.
# We set it here for the machines we don't have control on.
QB_ROOTFS_EXTRA_OPT:qemux86-64 += ",bootindex=0"
QB_ROOTFS_EXTRA_OPT:qemux86 += ",bootindex=0"

# Install the grubenv file deployed by oniro-grub-bootconf package into the EFI partition.
IMAGE_EFI_BOOT_FILES += "grubenv;EFI/BOOT/grubenv"

# Prefer Oniro-specific GRUB configuration file.
# (note r-provider is used below)
PREFERRED_RPROVIDER_virtual-grub-bootconf = "oniro-grub-bootconf"

# Default to enabling serial debug console on RaspberryPi
ENABLE_UART ?= "1"

GPU_MEM:raspberrypi4-64 = "128"
GPU_MEM:raspberrypi-armv7 = "128"

SPLASH = "psplash-oniro"

DISTRO_FEATURES_FILTER_NATIVE:append = " openharmony"
DISTRO_FEATURES_FILTER_NATIVESDK:append = " openharmony"
require conf/distro/include/openharmony.inc

# We run a read-only rootfs but we want shadow because it includes subid
# configuration used by podman in rootless mode.
ROOTFS_RO_UNNEEDED:remove = "shadow"

# Set default hostname to reflect the DISTRO
hostname:pn-base-files = "${DISTRO}-${MACHINE}"

# Workaround for https://bugzilla.yoctoproject.org/show_bug.cgi?id=14858
PACKAGE_EXCLUDE_COMPLEMENTARY:append = " openssh"

#
# Add support for Raspberry Pi 4 (64) in the Raspberry Pi 4 (64) builds.
#
MACHINE_EXTRA_RRECOMMENDS:append:raspberrypi4-64 = "\
    linux-firmware-rpidistro-bcm43430 \
    linux-firmware-rpidistro-bcm43455 \
    linux-firmware-rpidistro-bcm43456 \
    linux-firmware-rpidistro-bcm43436 \
    linux-firmware-rpidistro-bcm43436s \
    bluez-firmware-rpidistro-bcm43430a1-hcd \
    bluez-firmware-rpidistro-bcm43430b0-hcd \
    bluez-firmware-rpidistro-bcm4345c0-hcd \
    bluez-firmware-rpidistro-bcm4345c5-hcd \
"
RPI_KERNEL_DEVICETREE:raspberrypi4-64 = " \
    broadcom/bcm2710-rpi-3-b.dtb \
    broadcom/bcm2710-rpi-3-b-plus.dtb \
    broadcom/bcm2837-rpi-3-b.dtb \
    broadcom/bcm2710-rpi-cm3.dtb \
    broadcom/bcm2710-rpi-zero-2.dtb \
    broadcom/bcm2711-rpi-4-b.dtb \
    broadcom/bcm2711-rpi-400.dtb \
    broadcom/bcm2711-rpi-cm4.dtb \
"
# Don't advertise Raspberry Pi 4 as the machine in hostname to avoid confusion.
hostname:pn-base-files:raspberrypi4-64 = "${DISTRO}-raspberrypi"
```

## meta-oniro-core/conf/distro/oniro-zephyr.conf
```bitbake
# SPDX-FileCopyrightText: Huawei Inc.
#
# SPDX-License-Identifier: MIT

require conf/distro/include/oniro.inc
require conf/distro/zephyr.conf

ONIRO_FLAVOUR_PRETTY = "Zephyr"
DISTRO_VERSION = "2.0.0-beta"
```

## meta-oniro-core/conf/layer.conf
```bitbake
# SPDX-FileCopyrightText: Huawei Inc.
#
# SPDX-License-Identifier: Apache-2.0

# We have a conf and classes directory, add to BBPATH
BBPATH .= ":${LAYERDIR}"

# We have recipes-* directories, add to BBFILES
BBFILES += "${LAYERDIR}/recipes-*/*/*.bb \
            ${LAYERDIR}/recipes-*/*/*.bbappend"

BBFILE_COLLECTIONS += "oniro-core"
BBFILE_PATTERN_oniro-core = "^${LAYERDIR}/"
BBFILE_PRIORITY_oniro-core = "6"

LAYERDEPENDS_oniro-core = " \
    core \
    intel \
    meta-seco-imx \
    networking-layer \
    raspberrypi \
    rauc \
    security \
    tpm-layer \
    tpm2 \
    "
LAYERSERIES_COMPAT_oniro-core = "kirkstone"

ONIRO_COREBASE = '${@os.path.normpath("${LAYERDIR}/../")}'
```

## meta-oniro-core/conf/machine/include/qemu-efi.inc
```bitbake
# SPDX-FileCopyrightText: Huawei Inc.
#
# SPDX-License-Identifier: Apache-2.0

require conf/machine/include/qemu.inc

PREFERRED_PROVIDER_virtual/kernel ?= "linux-yocto"
KCONFIG_MODE = "--alldefconfig"
MACHINE_EXTRA_RRECOMMENDS += "kernel-modules linux-firmware"

SERIAL_CONSOLES ?= "115200;ttyAMA0 115200;hvc0"
SERIAL_CONSOLES_CHECK = "${SERIAL_CONSOLES}"

# This provides the bios for runqemu
EXTRA_IMAGEDEPENDS += "edk2-firmware"

IMAGE_FSTYPES += "wic wic.gz"
WKS_FILE ?= "x-gpt-efi-disk.wks.in"

# For runqemu
QB_MACHINE_VIRT_HIGHMEM ?= "on"
QB_MACHINE = "-machine virt,highmem=${QB_MACHINE_VIRT_HIGHMEM}"
QB_SMP = "-smp 4"
# For graphics to work we need to define the VGA device as well as the necessary USB devices
QB_GRAPHICS = "-device virtio-gpu-pci"
QB_OPT_APPEND = "-device qemu-xhci -device usb-tablet -device usb-kbd"
# Virtio Networking support
QB_TAP_OPT = "-netdev tap,id=net0,ifname=@TAP@,script=no,downscript=no"
QB_NETWORK_DEVICE = "-device virtio-net-pci,netdev=net0,mac=@MAC@"
# Virtio block device
QB_ROOTFS_OPT = "-drive id=disk0,file=@ROOTFS@,if=none,format=raw"
# Virtio serial console
QB_SERIAL_OPT = "-device virtio-serial-pci -chardev null,id=virtcon -device virtconsole,chardev=virtcon"
QB_TCPSERIAL_OPT = "-device virtio-serial-pci -chardev socket,id=virtcon,port=@PORT@,host=127.0.0.1 -device virtconsole,chardev=virtcon"

# Boot the wic image via EFI
QB_DEFAULT_FSTYPE = "wic"
QB_DEFAULT_KERNEL = "none"
QB_DEFAULT_BIOS = "uefi.bin"
QB_ROOTFS_EXTRA_OPT += "bootindex=0"
EFI_PROVIDER = "grub-efi"
MACHINE_FEATURES += "efi"
```

## meta-oniro-core/conf/machine/qemuarm-efi.conf
```bitbake
# SPDX-FileCopyrightText: Huawei Inc.
#
# SPDX-License-Identifier: Apache-2.0

#@TYPE: Machine
#@NAME: qemuarm-efi
#@DESCRIPTION: Qemu Arm machine that boots via EFI.

DEFAULTTUNE ?= "cortexa15t-neon"
require conf/machine/include/arm/armv7a/tune-cortexa15.inc
require conf/machine/include/qemu-efi.inc

KERNEL_IMAGETYPE ?= "zImage"

# Use the qemuarma15 kernel config as the base config of this machine
KMACHINE = "qemuarma15"

# For runqemu
QB_SYSTEM_NAME = "qemu-system-arm"
QB_MACHINE_VIRT_HIGHMEM = "off"
QB_CPU = "-cpu cortex-a15"
```

## meta-oniro-core/conf/machine/qemuarm64-efi.conf
```bitbake
# SPDX-FileCopyrightText: Huawei Inc.
#
# SPDX-License-Identifier: MIT

#@TYPE: Machine
#@NAME: qemuarm64-efi
#@DESCRIPTION: Qemu Arm64 machine that boots via EFI.

require conf/machine/include/arm/armv8a/tune-cortexa57.inc
require conf/machine/include/qemu-efi.inc

KERNEL_IMAGETYPE ?= "Image"

# Use the qemuarm64 kernel config as the base config of this machine 
KMACHINE = "qemuarm64"

# For runqemu
QB_SYSTEM_NAME = "qemu-system-aarch64"
QB_MACHINE_VIRT_HIGHMEM = "on"
QB_CPU = "-cpu cortex-a57"
```
