## Security challenge 4/meta-seclayer/conf/layer.conf
```bitbake
# We have a conf and classes directory, add to BBPATH
BBPATH .= ":${LAYERDIR}"

# We have recipes-* directories, add to BBFILES
BBFILES += "${LAYERDIR}/recipes-*/*/*.bb \
            ${LAYERDIR}/recipes-*/*/*.bbappend"

BBFILE_COLLECTIONS += "meta-seclayer"
BBFILE_PATTERN_meta-seclayer = "^${LAYERDIR}/"
BBFILE_PRIORITY_meta-seclayer = "10"

LAYERDEPENDS_meta-seclayer = "core"
LAYERSERIES_COMPAT_meta-seclayer = "kirkstone"
```

## conf/layer.conf
```bitbake
# We have a conf and classes directory, add to BBPATH
BBPATH .= ":${LAYERDIR}"

# We have recipes-* directories, add to BBFILES
BBFILES += "${LAYERDIR}/recipes-*/*/*.bb \
            ${LAYERDIR}/recipes-*/*/*.bbappend"

BBFILE_COLLECTIONS += "ohos-thirdparty"
BBFILE_PATTERN_ohos-thirdparty = "^${LAYERDIR}/"
BBFILE_PRIORITY_ohos-thirdparty = "6"

LAYERDEPENDS_ohos-thirdparty = "core"
LAYERSERIES_COMPAT_ohos-thirdparty = "gatesgarth"
```

## meta-ohos-acts/conf/layer.conf
```bitbake
# We have a conf and classes directory, add to BBPATH
BBPATH .= ":${LAYERDIR}"

# We have recipes-* directories, add to BBFILES
BBFILES += "${LAYERDIR}/recipes-*/*/*.bb \
            ${LAYERDIR}/recipes-*/*/*.bbappend"

BBFILE_COLLECTIONS += "meta-ohos-acts"
BBFILE_PATTERN_meta-ohos-acts = "^${LAYERDIR}/"
BBFILE_PRIORITY_meta-ohos-acts = "6"

LAYERDEPENDS_meta-ohos-acts = "core"
LAYERSERIES_COMPAT_meta-ohos-acts = "dunfell"

LICENSE_PATH += "${LAYERDIR}/custom-licenses"
```

## meta-ohos-blueprints/conf/distro/allscenarios-linux-blueprint-dashboard.conf
```bitbake
# SPDX-FileCopyrightText: Huawei Inc.
#
# SPDX-License-Identifier: Apache-2.0

# Distro configuration for the dashboard blueprint

require conf/distro/allscenarios-linux.conf
include conf/distro/include/ha-versions.inc

PREFERRED_VERSION_python3-pymetno = "0.7.0"

DISTRO = "allscenarios-linux-blueprint-dashboard"
DISTRO_NAME = "Oniro Project Dashboard Blueprint Linux Distro"

# Custom hostnames for easy DNS resolution for this blueprint.
# The gateway would run on a stm32mp1-av96 machine.
hostname_base-files_stm32mp1-av96 = "blueprint-dashboard-gateway"

# With our layer setup we would add any bbappend found from our
# layers.conf. This means blueprint-specific appends would leak
# into the package in our main distribution. To avoid this we
# mask out the blueprint layers in the main distro and unmask
# them only the blueprint distributions.
BBMASK = ""

# Avoid build warning(s) for ununsed extra partitions.
ST_VENDORFS = "0"
ST_USERFS = "0"

# Dynamic weston.ini configuration
WESTON_DYNAMIC_INI = "1"
WESTON_INI_NO_TOOLBAR = "1"

# Mask getty on tty1 to cleanup boot process
SYSTEMD_MASK_GETTY = "tty1"

EPIPHANY_APP = "HomeAssistant"
EPIPHANY_URL = "http://localhost:8123"
EPIPHANY_RDEPENDS = "python3-homeassistant"
EPIPHANY_SERVICE_ENABLED = "1"

WESTON_INI_BACKGROUND_IMAGE = "/usr/share/backgrounds/ostc-logo-small-loading.png"
WESTON_INI_BACKGROUND_COLOR = "0xffffffff"
WESTON_INI_BACKGROUND_TYPE = "centered"

# SmartHome IoT devices BLE interfaces MAC addresses
SMART_HOME_SENSORS_MAC ??= "C0:BA:DD:06:F0:0D"
SMART_HOME_SWITCH_MAC ??= "C0:BA:DD:06:F0:0E"
```

## meta-ohos-blueprints/conf/distro/allscenarios-linux-blueprint-vending-machine.conf
```bitbake
# SPDX-FileCopyrightText: Huawei Inc.
#
# SPDX-License-Identifier: Apache-2.0

# Distro configuration for the vending-machine blueprint

require conf/distro/allscenarios-linux.conf

DISTRO = "allscenarios-linux-blueprint-vending-machine"
DISTRO_NAME = "AllScenariOS Vending-Machine Blueprint Linux Distro"

# With our layer setup we would add any bbappend found from our
# layers.conf. This means blueprint-specific appends would leak
# into the package in our main distribution. To avoid this we
# mask out the blueprint layers in the main distro and unmask
# them only the blueprint distributions.
BBMASK = ""
```

## meta-ohos-blueprints/conf/distro/allscenarios-linux-demo-dashboard.conf
```bitbake
# SPDX-FileCopyrightText: Huawei Inc.
#
# SPDX-License-Identifier: Apache-2.0

# Deprecated distro configuration in favour of
# allscenarios-linux-blueprint-dashboard

require conf/distro/allscenarios-linux-blueprint-dashboard.conf

# We keep the old distro name to sanity check this deprecation.
DISTRO = "allscenarios-linux-demo-dashboard"
```

## meta-ohos-blueprints/conf/distro/allscenarios-zephyr-blueprint-dashboard.conf
```bitbake
# SPDX-FileCopyrightText: Huawei Inc.
#
# SPDX-License-Identifier: Apache-2.0

# Distro configuration for the dashboard blueprint

require conf/distro/allscenarios-zephyr.conf

DISTRO = "allscenarios-zephyr-blueprint-dashboard"
DISTRO_NAME = "AllScenariOS Dashboard Blueprint Zephyr Distro"

# With our layer setup we would add any bbappend found from our
# layers.conf. This means blueprint-specific appends would leak
# into the package in our main distribution. To avoid this we
# mask out the blueprint layers in the main distro and unmask
# them only the blueprint distributions.
BBMASK = ""

# SmartHome IoT devices BLE interfaces MAC addresses
SMART_HOME_SENSORS_MAC ??= "C0:BA:DD:06:F0:0D"
SMART_HOME_SWITCH_MAC ??= "C0:BA:DD:06:F0:0E"
```

## meta-ohos-blueprints/conf/distro/oniro-linux-demo-dashboard.conf
```bitbake
# SPDX-FileCopyrightText: Huawei Inc.
#
# SPDX-License-Identifier: Apache-2.0

# Deprecated distro configuration in favour of
# oniro-linux-blueprint-dashboard

require conf/distro/oniro-linux-blueprint-dashboard.conf

# We keep the old distro name to sanity check this deprecation.
DISTRO = "oniro-linux-demo-dashboard"
```

## meta-ohos-blueprints/conf/distro/openharmony-linux-blueprint-dashboard.conf
```bitbake
# SPDX-FileCopyrightText: Huawei Inc.
#
# SPDX-License-Identifier: Apache-2.0

# Distro configuration for the dashboard blueprint

require conf/distro/openharmony-linux.conf
include conf/distro/include/ha-versions.inc

DISTRO = "openharmony-linux-blueprint-dashboard"
DISTRO_NAME = "OpenHarmony Dashboard Blueprint Linux Distro"

# Custom hostnames for easy DNS resolution for this blueprint.
# The gateway would run on a stm32mp1-av96 machine.
hostname_base-files_stm32mp1-av96 = "blueprint-dashboard-gateway"

# Avoid build warning(s) for ununsed extra partitions.
ST_VENDORFS = "0"
ST_USERFS = "0"

# Dynamic weston.ini configuration
WESTON_DYNAMIC_INI = "1"
WESTON_INI_NO_TOOLBAR = "1"

# Mask getty on tty1 to cleanup boot process
SYSTEMD_MASK_GETTY = "tty1"

EPIPHANY_APP = "HomeAssistant"
EPIPHANY_URL = "http://localhost:8123"
EPIPHANY_RDEPENDS = "python3-homeassistant"
EPIPHANY_SERVICE_ENABLED = "1"

WESTON_INI_BACKGROUND_IMAGE = "/usr/share/backgrounds/ostc-logo-small-loading.png"
WESTON_INI_BACKGROUND_COLOR = "0xffffffff"
WESTON_INI_BACKGROUND_TYPE = "centered"
```

## meta-ohos-blueprints/conf/distro/openharmony-linux-demo-dashboard.conf
```bitbake
# SPDX-FileCopyrightText: Huawei Inc.
#
# SPDX-License-Identifier: Apache-2.0

# Deprecated distro configuration in favour of
# openharmony-linux-blueprint-dashboard

require conf/distro/openharmony-linux-blueprint-dashboard.conf

# We keep the old distro name to sanity check this deprecation.
DISTRO = "openharmony-linux-demo-dashboard"
```

## meta-ohos-blueprints/conf/layer.conf
```bitbake
# SPDX-FileCopyrightText: Huawei Inc.
#
# SPDX-License-Identifier: Apache-2.0

# We have a conf and classes directory, add to BBPATH
BBPATH .= ":${LAYERDIR}"

# We have recipes-* directories, add to BBFILES
BBFILES += "${LAYERDIR}/recipes-*/*/*.bb \
            ${LAYERDIR}/recipes-*/*/*.bbappend"

BBFILE_COLLECTIONS += "meta-ohos-blueprints"
BBFILE_PATTERN_meta-ohos-blueprints = "^${LAYERDIR}/"
BBFILE_PRIORITY_meta-ohos-blueprints = "6"

LAYERDEPENDS_meta-ohos-blueprints = "core"
LAYERSERIES_COMPAT_meta-ohos-blueprints = "dunfell"
```

## meta-ohos-core/conf/distro/allscenarios-linux.conf
```bitbake
# SPDX-FileCopyrightText: Huawei Inc.
#
# SPDX-License-Identifier: Apache-2.0

require conf/distro/include/allscenarios.inc
require conf/distro/include/x-wic.inc
require conf/distro/poky.conf

DISTRO = "allscenarios-linux"
DISTRO_NAME = "AllScenariOS Base Linux Distro"
DISTRO_VERSION = "1.0.0-alpha"

TCLIBC ?= "musl"

BINUVERSION ?= "2.37%"
GCCVERSION ?= "11.%"
GLIBCVERSION ?= "2.33%"

INIT_MANAGER = "systemd"

# Remove some of the default Poky DISTRO_FEATURES we inherited, but do not use.
DISTRO_FEATURES_remove = " nfs nfc 3g pcmcia"

# Remove some of the default Poky IMAGE_FEATURES we inherited, but do not need.
IMAGE_FEATURES_remove = " nfs-server nfs-client nfs-utils"

# Remove some of the default Poky runtime dependencies that have no use
DISTRO_EXTRA_RDEPENDS_remove = " packagegroup-core-device-devel"

PREFERRED_VERSION_linux-yocto = "5.10%"

# Default to enabling serial debug console on RaspberryPi
ENABLE_UART ?= "1"

# We have no use for dlt-daemon as we use systemd for logging
PACKAGECONFIG_remove_pn-mosquitto = "dlt"
```

## meta-ohos-core/conf/distro/allscenarios-zephyr.conf
```bitbake
# SPDX-FileCopyrightText: Huawei Inc.
#
# SPDX-License-Identifier: Apache-2.0

require conf/distro/include/allscenarios.inc
require conf/distro/zephyr.conf

DISTRO = "allscenarios-zephyr"
DISTRO_NAME = "AllScenariOS Base Zephyr Distro"
DISTRO_VERSION = "1.0.0-alpha"
```

## meta-ohos-core/conf/distro/include/allscenarios.inc
```bitbake
# SPDX-FileCopyrightText: Huawei Inc.
#
# SPDX-License-Identifier: Apache-2.0

INHERIT += "ohos-sanity"

# With our layer setup we would add any bbappend found from our
# layers.conf. This means blueprint-specific appends would leak
# into the package in our main distribution. To avoid this we
# mask out the blueprint layers in the main distro and unmask
# them only the blueprint distributions.
BBMASK += "meta-ohos/meta-ohos-blueprints/"
```

## meta-ohos-core/conf/distro/include/x-wic.inc
```bitbake
# SPDX-FileCopyrightText: Huawei Inc.
#
# SPDX-License-Identifier: Apache-2.0

# WIC configuration definitions that are meant to be common across the
# supported devices. This configuration is taking into consideration OTA design
# and strategies.

BOOT_PARTITION_SIZE ?= "512M"
# The SECO B68 board pulls in almost half a Gigabyte worth of linux-firmware.
ROOT_PARTITION_SIZE_seco-intel-b68 ?= "1536M"
ROOT_PARTITION_SIZE ?= "1G"
ROOTA_PARTITION_SIZE = "${ROOT_PARTITION_SIZE}"
ROOTB_PARTITION_SIZE = "${ROOT_PARTITION_SIZE}"
DEVDATA_PARTITION_SIZE ?= "8M"
SYSDATA_PARTITION_SIZE ?= "512M"
APPDATA_PARTITION_SIZE ?= "1G"

# Default root filesystem type is squashfs.
ROOT_FSTYPE ?= "squashfs"

#
# Use this to include extra wic configuration per partition
#
WIC_ROOTA_PARTITION_EXTRA_ARGS ??= ""
WIC_ROOTB_PARTITION_EXTRA_ARGS ??= ""
WIC_DEVDATA_PARTITION_EXTRA_ARGS ??= ""
WIC_SYSDATA_PARTITION_EXTRA_ARGS ??= ""
WIC_APPDATA_PARTITION_EXTRA_ARGS ??= ""

WIC_ROOTA_PARTITION ?= "part / --source rootfs --use-uuid --fstype=${ROOT_FSTYPE} \
                        ${@bb.utils.contains('ROOT_FSTYPE', 'ext4', '--mkfs-extraopts \'-T default\'', '', d)} \
                        --align 4096 --fixed-size ${ROOTA_PARTITION_SIZE} \
			${WIC_ROOTA_PARTITION_EXTRA_ARGS}"
WIC_ROOTB_PARTITION ?= "part / --source rootfs --use-uuid --fstype=${ROOT_FSTYPE} \
                        ${@bb.utils.contains('ROOT_FSTYPE', 'ext4', '--mkfs-extraopts \'-T default\'', '', d)} \
                        --align 4096 --fixed-size ${ROOTB_PARTITION_SIZE} \
                        ${WIC_ROOTB_PARTITION_EXTRA_ARGS}"
WIC_DEVDATA_PARTITION ?= "part --fstype=ext4 --label x-dev-data --mkfs-extraopts '-T default' --align 4096 --fixed-size ${DEVDATA_PARTITION_SIZE} ${WIC_DEVDATA_PARTITION_EXTRA_ARGS}"
WIC_SYSDATA_PARTITION ?= "part --fstype=ext4 --label x-sys-data --mkfs-extraopts '-T default' --align 4096 --fixed-size ${SYSDATA_PARTITION_SIZE} ${WIC_SYSDATA_PARTITION_EXTRA_ARGS}"
WIC_APPDATA_PARTITION ?= "part --fstype=ext4 --label x-app-data --mkfs-extraopts '-T default' --align 4096 --fixed-size ${APPDATA_PARTITION_SIZE} ${WIC_APPDATA_PARTITION_EXTRA_ARGS}"
```

## meta-ohos-core/conf/distro/openharmony-linux.conf
```bitbake
require conf/distro/poky.conf

DISTRO = "openharmony-linux"
DISTRO_NAME = "OpenHarmony Base Linux Distro"
DISTRO_VERSION = "0.1"

TCLIBC = "musl"

INIT_MANAGER = "systemd"

# Remove some of the default Poky DISTRO_FEATURES we inherited, but do not use.
DISTRO_FEATURES_remove = "nfc 3g pcmcia"
```

## meta-ohos-core/conf/distro/openharmony-zephyr.conf
```bitbake
# SPDX-FileCopyrightText: Huawei Inc.
#
# SPDX-License-Identifier: Apache-2.0

require conf/distro/zephyr.conf

DISTRO = "openharmony-zephyr"
DISTRO_NAME = "OpenHarmony Base Zephyr Distro"
DISTRO_VERSION = "0.1"
```

## meta-ohos-core/conf/layer.conf
```bitbake
# We have a conf and classes directory, add to BBPATH
BBPATH .= ":${LAYERDIR}"

# We have recipes-* directories, add to BBFILES
BBFILES += "${LAYERDIR}/recipes-*/*/*.bb \
            ${LAYERDIR}/recipes-*/*/*.bbappend"

BBFILE_COLLECTIONS += "meta-ohos-core"
BBFILE_PATTERN_meta-ohos-core = "^${LAYERDIR}/"
BBFILE_PRIORITY_meta-ohos-core = "6"

LAYERDEPENDS_meta-ohos-core = "core"
LAYERSERIES_COMPAT_meta-ohos-core = "dunfell"
```

## meta-ohos-demo/conf/distro/openharmony-linux-demo-dashboard.conf
```bitbake
# SPDX-FileCopyrightText: Huawei Inc.
#
# SPDX-License-Identifier: Apache-2.0

# Distro configuration for the dashboard demo

# Epiphany fails with musl
# https://bugzilla.yoctoproject.org/show_bug.cgi?id=14281
TCLIBC ?= "glibc"

require conf/distro/openharmony-linux.conf
include conf/distro/include/ha-versions.inc

DISTRO = "openharmony-linux-demo-dashboard"
DISTRO_NAME = "OpenHarmony Dashboard Demo Linux Distro"

# Custom hostnames for easy DNS resolution for this demo.
# The gateway would run on a stm32mp1-av96 machine.
hostname_base-files_stm32mp1-av96 = "demo-dashboard-gateway"

# Avoid build warning(s) for ununsed extra partitions.
ST_VENDORFS = "0"
ST_USERFS = "0"

# Dynamic weston.ini configuration
WESTON_DYNAMIC_INI = "1"
WESTON_INI_NO_TOOLBAR = "1"

# Mask getty on tty1 to cleanup boot process
SYSTEMD_MASK_GETTY = "tty1"

EPIPHANY_APP = "HomeAssistant"
EPIPHANY_URL = "http://localhost:8123"
EPIPHANY_RDEPENDS = "python3-homeassistant"
EPIPHANY_SERVICE_ENABLED = "1"

WESTON_INI_BACKGROUND_IMAGE = "/usr/share/backgrounds/ostc-logo-small-loading.png"
WESTON_INI_BACKGROUND_COLOR = "0xffffffff"
WESTON_INI_BACKGROUND_TYPE = "centered"
```

## meta-ohos-demo/conf/layer.conf
```bitbake
# SPDX-FileCopyrightText: Huawei Inc.
#
# SPDX-License-Identifier: Apache-2.0

# This layer was deprecated in favour of meta-ohos-blueprints. This is a
# compatible layer to not break existing bblayers.conf.
BBPATH .= ":${LAYERDIR}/../meta-ohos-blueprints"

# We have recipes-* directories, add to BBFILES
BBFILES += "${LAYERDIR}/../meta-ohos-blueprints/recipes-*/*/*.bb \
            ${LAYERDIR}/../meta-ohos-blueprints/recipes-*/*/*.bbappend"

BBFILE_COLLECTIONS += "meta-ohos-demo"
BBFILE_PATTERN_meta-ohos-demo = "^${LAYERDIR}/../meta-ohos-blueprints"
BBFILE_PRIORITY_meta-ohos-demo = "6"

LAYERDEPENDS_meta-ohos-demo = "core"
LAYERSERIES_COMPAT_meta-ohos-demo = "dunfell"
```

## meta-ohos-foundation/conf/layer.conf
```bitbake
# We have a conf and classes directory, add to BBPATH
BBPATH .= ":${LAYERDIR}"

# We have recipes-* directories, add to BBFILES
BBFILES += "${LAYERDIR}/recipes-*/*/*.bb \
            ${LAYERDIR}/recipes-*/*/*.bbappend"

BBFILE_COLLECTIONS += "ohos-foundation"
BBFILE_PATTERN_ohos-foundation = "^${LAYERDIR}/"
BBFILE_PRIORITY_ohos-foundation = "6"

LAYERDEPENDS_ohos-foundation = "core"
LAYERSERIES_COMPAT_ohos-foundation = "dunfell gatesgarth"
```
