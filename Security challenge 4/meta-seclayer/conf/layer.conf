## meta-ohos-staging/conf/layer.conf
```bitbake
# SPDX-FileCopyrightText: Huawei Inc.
#
# SPDX-License-Identifier: Apache-2.0

# We have a conf directory, add to BBPATH
BBPATH .= ":${LAYERDIR}"

# We have recipes-* directories, add to BBFILES
BBFILES += "${LAYERDIR}/recipes-*/*/*.bb \
            ${LAYERDIR}/recipes-*/*/*.bbappend"

# We have .bbappend files to recipes in layers that we want to have as optional
BBFILES_DYNAMIC += "\
    stm-st-stm32mp:${LAYERDIR}/dynamic-layers/meta-st-stm32mp/recipes-*/*/*.bb \
    stm-st-stm32mp:${LAYERDIR}/dynamic-layers/meta-st-stm32mp/recipes-*/*/*.bbappend \
"

BBFILE_COLLECTIONS += "meta-ohos-staging"
BBFILE_PATTERN_meta-ohos-staging = "^${LAYERDIR}/"
BBFILE_PRIORITY_meta-ohos-staging = "5"

LAYERDEPENDS_meta-ohos-staging = "core"
LAYERSERIES_COMPAT_meta-ohos-staging = "dunfell"
```

## meta-oniro-blueprints/conf/distro/oniro-linux-blueprint-gateway.conf
```bitbake
# SPDX-FileCopyrightText: Huawei Inc.
#
# SPDX-License-Identifier: Apache-2.0

# Distro configuration for the dashboard blueprint

require conf/distro/oniro-linux.conf

DISTRO = "oniro-linux-blueprint-gateway"
DISTRO_NAME = "Oniro Project Gateway Blueprint Linux Distro"

# Custom hostnames for easy DNS resolution for this blueprint.
hostname_base-files = "blueprint-gateway"

DISTRO_FEATURES_append = " thread-border-router"

IMAGE_INSTALL_append = "\
    packagegroup-thread-br \
    packagegroup-thread-client \
    mosquitto \
    coap \
    networkmanager-softap-config \
    "
# Avoid build warning(s) for ununsed extra partitions.
ST_VENDORFS = "0"
ST_USERFS = "0"

# With our layer setup we would add any bbappend found from our
# layers.conf. This means blueprint-specific appends would leak
# into the package in our main distribution. To avoid this we
# mask out the blueprint layers in the main distro and unmask
# them only the blueprint distributions.
BBMASK = ""

# If dnsmaq runs as system service started by systemd it clashes with NM, which
# directly calls it.
SYSTEMD_AUTO_ENABLE_pn-dnsmasq = "disable"

# We have the dnsmasq feature disabled for networkmanager in core,
# but we need this for the gateway. Enable it for the blueprint only.
PACKAGECONFIG_append_pn-networkmanager = " dnsmasq"
```

## meta-oniro-blueprints/conf/distro/oniro-linux-blueprint-vending-machine.conf
```bitbake
# SPDX-FileCopyrightText: Huawei Inc.
#
# SPDX-License-Identifier: Apache-2.0

# Distro configuration for the vending-machine blueprint

require conf/distro/oniro-linux.conf

DISTRO = "oniro-linux-blueprint-vending-machine"
DISTRO_NAME = "Oniro Project Vending-Machine Blueprint Linux Distro"

# With our layer setup we would add any bbappend found from our
# layers.conf. This means blueprint-specific appends would leak
# into the package in our main distribution. To avoid this we
# mask out the blueprint layers in the main distro and unmask
# them only the blueprint distributions.
BBMASK = ""

# Graphics system
DISTRO_FEATURES_remove = "x11"

# Lib configuration needed for some applications in layer
LVGL_CONFIG_LV_MEM_CUSTOM = "1"
LVGL_CONFIG_WAYLAND_HOR_RES ?= "1024"
LVGL_CONFIG_WAYLAND_VER_RES ?= "600"

# Dynamic weston.ini configuration
WESTON_DYNAMIC_INI = "1"
WESTON_INI_NO_TOOLBAR = "1"
WESTON_INI_SHELL_LOCKING = "false"
WESTON_IDLE_TIME = "0"

# I2C support
# See Hardware setup for more details.
ENABLE_I2C_rpi = "1"
KERNEL_MODULE_AUTOLOAD_rpi += "i2c-dev i2c-bcm2708"

VC4DTBO_raspberrypi4-64 = "vc4-kms-v3d"
GPU_MEM_raspberrypi4-64 = "128"

WAVESHARE_1024X600_C_2_1 = "1"

# Mask getty on tty1 to cleanup boot process
SYSTEMD_MASK_GETTY = "tty1"

# Cleanup screen
APPEND_remove = "console=tty0"
APPEND_append = " vt.global_cursor_default=0 quiet"
DISABLE_SPLASH_rpi = "1"
WIC_BOOOTLOADER_TIMEOUT = "0"
```

## meta-oniro-blueprints/conf/distro/oniro-zephyr-blueprint-doorlock.conf
```bitbake
# SPDX-FileCopyrightText: Huawei Inc.
#
# SPDX-License-Identifier: Apache-2.0

# Distro configuration for the dashboard blueprint

require conf/distro/oniro-zephyr.conf

DISTRO = "oniro-zephyr-blueprint-doorlock"
DISTRO_NAME = "Oniro Project Doorlock Blueprint Zephyr Distro"

# With our layer setup we would add any bbappend found from our
# layers.conf. This means blueprint-specific appends would leak
# into the package in our main distribution. To avoid this we
# mask out the blueprint layers in the main distro and unmask
# them only the blueprint distributions.
BBMASK = ""
```
